## subsys/bluetooth/services/Kconfig.hids_c
```kconfig
menuconfig BT_GATT_HIDS_C
	bool "HID service client"
	help
	  Enable HID GATT Human Interface Device service client.

if BT_GATT_HIDS_C

choice
	prompt "HIDS Client logging level"
	default BT_GATT_HIDS_C_LOG_LEVEL_DBG

config BT_GATT_HIDS_C_LOG_LEVEL_OFF
	bool "Off"
config BT_GATT_HIDS_C_LOG_LEVEL_ERR
	bool "Error"
config BT_GATT_HIDS_C_LOG_LEVEL_WRN
	bool "Warning"
config BT_GATT_HIDS_C_LOG_LEVEL_INF
	bool "Info"
config BT_GATT_HIDS_C_LOG_LEVEL_DBG
	bool "Debug"

endchoice

config BT_GATT_HIDS_C_LOG_LEVEL
	int
	default 0 if BT_GATT_HIDS_C_LOG_LEVEL_OFF
	default 1 if BT_GATT_HIDS_C_LOG_LEVEL_ERR
	default 2 if BT_GATT_HIDS_C_LOG_LEVEL_WRN
	default 3 if BT_GATT_HIDS_C_LOG_LEVEL_INF
	default 4 if BT_GATT_HIDS_C_LOG_LEVEL_DBG

config BT_GATT_HIDS_REPORTS_MAX
	int "Maximum number of reports supported"
	default 8
	help
	  The number of reports supported by all the HIDS clients used.
	  The report pool would be common to all HIDS client objects created.

endif # BT_GATT_HIDS_C
```
